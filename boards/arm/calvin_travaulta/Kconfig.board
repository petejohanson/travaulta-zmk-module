## boards/arm/calvin_travaulta/Kconfig.board
```kconfig
# Travaulta board configuration

# Copyright (c) 2024 The ZMK Contributors
# SPDX-License-Identifier: MIT

config BOARD_CALVIN_TRAVAULTA
    bool "Travaulta"
    depends on SOC_STM32401XC
```

## boards/arm/calvin_travaulta/Kconfig.defconfig
```kconfig
# Travaulta board configuration

# Copyright (c) 2024 The ZMK Contributors
# SPDX-License-Identifier: MIT

if BOARD_CALVIN_TRAVAULTA

config BOARD
    default "calvin_travaulta"

config ZMK_KEYBOARD_NAME
    default "Travaulta"

endif # BOARD_CALVIN_TRAVAULTA
```

## boards/arm/calvin_travaulta/calvin_travaulta_defconfig
```kconfig
# SPDX-License-Identifier: MIT

CONFIG_BOARD_CALVIN_TRAVAULTA=y

CONFIG_SOC_SERIES_STM32F4X=y
CONFIG_SOC_STM32F401XC=y

# Enable MPU
CONFIG_ARM_MPU=y

# Enable HW stack protection
CONFIG_HW_STACK_PROTECTION=y

# enable PINMUX
CONFIG_PINCTRL=y

# enable GPIO
CONFIG_GPIO=y

# Enable i2c
CONFIG_ADC=y

# ZMK Settings
CONFIG_ZMK_USB=y

# Settings subsystem
CONFIG_SETTINGS=y
CONFIG_FLASH=y
CONFIG_FLASH_MAP=y
CONFIG_NVS=y
CONFIG_SETTINGS_NVS=y

CONFIG_USB_SELF_POWERED=n

# clock configuration
CONFIG_CLOCK_CONTROL=y
```
